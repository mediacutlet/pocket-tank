## firmware/main/Kconfig.projbuild
```kconfig
menu "pocket-tank"
    config POCKET_TANK_DISPLAY_SH8601
        bool "Drive the Waveshare 1.8in AMOLED (SH8601 / CO5300 over QSPI)"
        default n
        help
            Enable for the real board. Off = stub display port (QEMU / compile-only).
    config POCKET_TANK_ROUND
        bool "The ROUND build: a 466 px bowl for the Waveshare ESP32-S3-Touch-AMOLED-1.75C"
        default n
        help
            The tank's world is compiled in: off = the 448x368 rectangle (the
            1.8 board; on a 1.75C that image still runs, the frame shown inside
            the circle). On = TANK_ROUND, the bowl that fills the round glass;
            that image shows nothing on a 1.8. Build it with
            SDKCONFIG_DEFAULTS="sdkconfig.defaults;sdkconfig.round" into its
            own build directory and sdkconfig (docs/board-amoled-1.75c.md).
    config POCKET_TANK_WATCH
        bool "The WATCH build: a 410x502 PORTRAIT tank for the Waveshare ESP32-S3-Touch-AMOLED-2.06"
        default n
        depends on !POCKET_TANK_ROUND
        help
            On = TANK_WATCH: a tall tank the way a watch is worn, with the
            round corners of its glass; that image shows nothing on the
            other boards. Off, the 448x368 rectangle image still runs on a
            watch, on its side and centred in the glass. Build it with
            SDKCONFIG_DEFAULTS="sdkconfig.defaults;sdkconfig.watch" into its
            own build directory and sdkconfig (docs/board-amoled-2.06-watch.md).
    config POCKET_TANK_SQUARE
        bool "The SQUARE build: a 480x480 tank for the Waveshare ESP32-S3-Touch-AMOLED-2.16"
        default n
        depends on !POCKET_TANK_ROUND && !POCKET_TANK_WATCH
        help
            On = TANK_SQUARE: the tank fills the 2.16's square glass; that
            image shows nothing on the other boards. Build it with
            SDKCONFIG_DEFAULTS="sdkconfig.defaults;sdkconfig.square" into its
            own build directory and sdkconfig (docs/board-amoled-2.16.md).
    config POCKET_TANK_TOUCH_FT3168
        bool "Read the FT3168 capacitive touch (taps / holds)"
        default n
    config POCKET_TANK_TAB5
        bool "The TAB5 build: a 720x405 landscape tank for the M5Stack Tab5 (ESP32-P4)"
        default n
        depends on !POCKET_TANK_ROUND && !POCKET_TANK_WATCH && !POCKET_TANK_SQUARE
        help
            On = TANK_TAB5: a 16:9 world the display port turns a quarter turn
            and scales onto the Tab5's 720x1280 MIPI-DSI glass, so the tank
            fills it landscape. Build it (ESP-IDF v5.4.2, target esp32p4) with
            SDKCONFIG_DEFAULTS="sdkconfig.defaults;sdkconfig.tab5" into its own
            build directory and sdkconfig (docs/board-tab5.md).
    config POCKET_TANK_DISPLAY_TAB5
        bool "Drive the Tab5's 720x1280 MIPI-DSI panel (ILI9881C, 2 DSI lanes)"
        default n
        help
            The P4's MIPI-DSI DPI panel + the pixel-processing accelerator that
            turns and scales the tank onto it. On = display_port_tab5.c.
    config POCKET_TANK_TOUCH_GT911
        bool "Read the Tab5's GT911 capacitive touch"
        default n
    config POCKET_TANK_AUDIO_ES8311
        bool "Play the sound bank through the ES8311 codec + NS4150B amp (I2S)"
        default n
        help
            Enable for the real board (docs/AUDIO.md). Off = stub audio port: cues compile, nothing plays.
    config POCKET_TANK_AUDIO_TAB5
        bool "Play the sound bank through the Tab5's ES8388 + speaker amp (I2S, via the BSP)"
        default n
        help
            The Tab5's codec is an ES8388 (I2C 0x10) and its speaker amp hangs off
            the IO expander, so this port lets Espressif's Tab5 BSP own the I2S
            channel and the codec and runs only the tank's mixer, power and settle
            behaviour on top (audio_port_tab5.c). Off = stub audio port.
    config POCKET_TANK_NO_PIE
        bool "Disable the PIE SIMD inference kernel (scalar dot products)"
        default n
        help
            Enable for a QEMU build if the emulator lacks ESP32-S3 PIE support.
endmenu
```
