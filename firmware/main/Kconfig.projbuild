## firmware/main/Kconfig.projbuild
```kconfig
menu "pocket-tank"
    choice POCKET_TANK_BOARD
        prompt "Board"
        default POCKET_TANK_BOARD_AMOLED18
        help
            Which board the firmware is built for. Selects the pins, the tank
            size (common/tank.h) and which display / touch ports can be used.
            (this fork) Each 320x240 board selects POCKET_TANK_320X240, the
            part they share; its own entry carries what is its alone.
        config POCKET_TANK_BOARD_AMOLED18
            bool "Waveshare ESP32-S3-Touch-AMOLED-1.8 (448x368)"
        config POCKET_TANK_CYD_320X240
            bool "CYD at 320x240: the 2.8in ESP32-S3 ES3C28P, ILI9341 + FT6336"
            select POCKET_TANK_320X240
        config POCKET_TANK_WST_320X240
            bool "Waveshare ESP32-S3-Touch-LCD-2 at 320x240: ST7789T3 + CST816D"
            select POCKET_TANK_320X240
    endchoice
    config POCKET_TANK_320X240
        bool
        help
            The 320x240 layout every 320x240 board shares (this fork,
            2026-10-08): common/tank.h's 320x240 tank and the pages laid out
            for it, touch already landscape from the driver with no finger
            bias, the settings page's compact rows, no update channel (OTA
            hidden), the CYD's old saves read back, the algae paced for its
            300 cells, and the sleep modes that go dark (screen, lightsleep)
            with the settings page's SLEEP row. Not chosen by hand: the board
            entries above select it, and tankcore's CMakeLists hands it to
            common/.
    config POCKET_TANK_DISPLAY_ILI9341
        bool "Drive the CYD's ILI9341 over SPI, backlight PWM on GPIO45"
        depends on POCKET_TANK_CYD_320X240
        default n
    config POCKET_TANK_DISPLAY_ST7789
        bool "Drive the Touch-LCD-2's ST7789T3 over SPI, backlight PWM"
        depends on POCKET_TANK_WST_320X240
        default n
    config POCKET_TANK_DISPLAY_SH8601
        bool "Drive the Waveshare 1.8in AMOLED (SH8601 / CO5300 over QSPI)"
        default n
        help
            Enable for the real board. Off = stub display port (QEMU / compile-only).
    config POCKET_TANK_ROUND
        bool "The ROUND build: a 466 px bowl for the Waveshare ESP32-S3-Touch-AMOLED-1.75C"
        default n
        help
            The tank's world is compiled in: off = the 448x368 rectangle (the
            1.8 board; on a 1.75C that image still runs, the frame shown inside
            the circle). On = TANK_ROUND, the bowl that fills the round glass;
            that image shows nothing on a 1.8. Build it with
            SDKCONFIG_DEFAULTS="sdkconfig.defaults;sdkconfig.round" into its
            own build directory and sdkconfig (docs/board-amoled-1.75c.md).
    config POCKET_TANK_WATCH
        bool "The WATCH build: a 410x502 PORTRAIT tank for the Waveshare ESP32-S3-Touch-AMOLED-2.06"
        default n
        depends on !POCKET_TANK_ROUND
        help
            On = TANK_WATCH: a tall tank the way a watch is worn, with the
            round corners of its glass; that image shows nothing on the
            other boards. Off, the 448x368 rectangle image still runs on a
            watch, on its side and centred in the glass. Build it with
            SDKCONFIG_DEFAULTS="sdkconfig.defaults;sdkconfig.watch" into its
            own build directory and sdkconfig (docs/board-amoled-2.06-watch.md).
    config POCKET_TANK_SQUARE
        bool "The SQUARE build: a 480x480 tank for the Waveshare ESP32-S3-Touch-AMOLED-2.16"
        default n
        depends on !POCKET_TANK_ROUND && !POCKET_TANK_WATCH
        help
            On = TANK_SQUARE: the tank fills the 2.16's square glass; that
            image shows nothing on the other boards. Build it with
            SDKCONFIG_DEFAULTS="sdkconfig.defaults;sdkconfig.square" into its
            own build directory and sdkconfig (docs/board-amoled-2.16.md).
    config POCKET_TANK_P4
        bool "The HOME TANK build: a 640x400 tank shown at 2x on the Waveshare ESP32-P4-WIFI6-Touch-LCD-10.1"
        default n
        depends on IDF_TARGET_ESP32P4
        help
            On = TANK_P4: the rectangle's world a half again as wide, drawn 2x
            by the P4's PPA onto its 1280x800 IPS glass. Its own target (an
            ESP32-P4, ESP-IDF 5.5): tools/flash_p4.sh builds it with
            SDKCONFIG_DEFAULTS="sdkconfig.defaults;sdkconfig.p4" into its own
            build directory (docs/board-p4-10.1.md).
    config POCKET_TANK_TAB5
        bool "The SMALL HOME TANK: the P4 home tank build on the M5Stack Tab5 (5in 1280x720)"
        default n
        depends on POCKET_TANK_P4
        help
            On = TANK_TAB5 beside TANK_P4: the home tank's world 720 tall, the
            Tab5's ST7121 / ST7123 / ILI9881C panel, its touch, its PI4IOE5V6408
            expanders. tools/flash_tab5.sh builds it with
            SDKCONFIG_DEFAULTS="sdkconfig.defaults;sdkconfig.p4;sdkconfig.tab5"
            (docs/board-tab5.md).
    config POCKET_TANK_P4_LCD7
        bool "BETA: the home tank on the Waveshare ESP32-P4-WIFI6-Touch-LCD-7 (7in 720x1280, ILI9881C)"
        default n
        depends on POCKET_TANK_P4 && !POCKET_TANK_TAB5
        help
            On = TANK_P4_LCD7 + TANK_TAB5's 720-tall world: the 10.1's board
            (pins, codec, touch chip, console) with Waveshare's 7 inch panel -
            an ILI9881C at 1000 Mbps a lane and its panel controller at I2C
            0x45. Untried on a board (nobody here owns one): BETA.
            tools/flash_p4_beta.sh 7 builds it with
            SDKCONFIG_DEFAULTS="sdkconfig.defaults;sdkconfig.p4;sdkconfig.p4lcd7"
            (docs/board-p4-7-8-beta.md). Not the -7B (1024x600): another board.
    config POCKET_TANK_P4_LCD8
        bool "BETA: the home tank on the Waveshare ESP32-P4-WIFI6-Touch-LCD-8 (8in 800x1280, JD9365)"
        default n
        depends on POCKET_TANK_P4 && !POCKET_TANK_TAB5 && !POCKET_TANK_P4_LCD7
        help
            On = TANK_P4_LCD8: the 10.1's image with the 8 inch panel's own
            JD9365 init table (Waveshare's BSP). Untried on a board: BETA.
            tools/flash_p4_beta.sh 8 (docs/board-p4-7-8-beta.md).
    config POCKET_TANK_DISPLAY_JD9365
        bool "Drive the Waveshare 10.1in IPS (JD9365 over MIPI-DSI, the P4 home tank)"
        default n
        depends on IDF_TARGET_ESP32P4
    config POCKET_TANK_NO_RADIO
        bool "No radio in this image: the network and link ports are stubs"
        default n
        help
            The P4's radio is a C6 over esp-hosted, not the esp_wifi driver:
            until that path is in, its image carries no Wi-Fi (no update
            page, no tank link, no internet time). Every port still answers.
    config POCKET_TANK_RADIO_HOSTED
        bool "The P4's radio: the C6 beside it through esp_hosted, the tank link through our relay"
        default n
        depends on IDF_TARGET_ESP32P4
        help
            The home tank WITH its radio chip (docs/board-p4-10.1.md, "The
            radio"): link_port_hosted.c speaks ESP-NOW through the C6's
            relay (firmware-c6/). The network port is still the stub. Built
            by tools/flash_p4.sh --radio (PT_P4_RADIO=1 brings the hosted
            components into the build; sdkconfig.p4radio sets this).
    config POCKET_TANK_CONSOLE_UART
        bool "The director console on UART0 instead of the USB serial port"
        default n
        help
            The P4 board's native USB port is not wired to its Type-C: the
            bench talks over the CH343 UART bridge (UART0, 115200).
    config POCKET_TANK_TOUCH_FT3168
        bool "Read the FT3168 capacitive touch (taps / holds)"
        default n
    config POCKET_TANK_AUDIO_ES8311
        bool "Play the sound bank through the ES8311 codec + NS4150B amp (I2S)"
        default n
        depends on !POCKET_TANK_WST_320X240
        help
            Enable for the real board (docs/AUDIO.md). Off = stub audio port: cues compile, nothing plays.
            (this fork, 2026-10-08) Not offered on the Touch-LCD-2, which has
            no codec: the port would drive the AMOLED's I2S pins there, and
            its word select, GPIO45, is that board's LCD chip select.
    config POCKET_TANK_IMU_QMI8658
        bool "Look for a QMI8658 IMU (I2C 0x6B / 0x6A)"
        default y
        help
            The AMOLED board's IMU, the Touch-LCD-2's, and the part the CYD
            is waiting for.
            Probed first at boot; the screen's 180-degree flip and the
            handling detector run on whichever enabled IMU answers.
    config POCKET_TANK_IMU_QMI8658_UP_AXIS
        int "QMI8658: the axis along the screen's up (0=X 1=Y 2=Z)"
        range 0 2
        default 1
        depends on POCKET_TANK_IMU_QMI8658
        help
            The default is the AMOLED board's, calibrated 2026-08-28. A
            QMI8658 mounted elsewhere is a bench fact: hold the board right
            side up and run the director's `imu`.
    config POCKET_TANK_IMU_QMI8658_UP_NEGATIVE
        bool "QMI8658: that axis reads negative when held right side up"
        default y
        depends on POCKET_TANK_IMU_QMI8658
    config POCKET_TANK_IMU_QMI8658_OUT_AXIS
        int "QMI8658: the axis out of the glass (0=X 1=Y 2=Z)"
        range 0 2
        default 2
        depends on POCKET_TANK_IMU_QMI8658
    config POCKET_TANK_IMU_QMI8658_OUT_NEGATIVE
        bool "QMI8658: that axis reads negative lying flat, screen up"
        default n
        depends on POCKET_TANK_IMU_QMI8658
        help
            Only the face-down gesture uses it. Not measured on the AMOLED,
            which does not enable the gesture.
    config POCKET_TANK_IMU_MPU6050
        bool "Look for an MPU-6050 IMU (I2C 0x68 / 0x69)"
        default y if POCKET_TANK_CYD_320X240
        default n
        help
            The CYD has no IMU of its own; an MPU-6050 breakout on its I2C
            socket stands in (CYD.md). Probed after the QMI8658, so a
            board carrying both uses the QMI8658.
    config POCKET_TANK_IMU_MPU6050_UP_AXIS
        int "MPU-6050: the axis along the screen's up (0=X 1=Y 2=Z)"
        range 0 2
        default 1
        depends on POCKET_TANK_IMU_MPU6050
        help
            A bench fact, because the breakout is mounted by hand: hold the
            board right side up and run the director's `imu`; the axis
            carrying about 16000 counts is this one.
    config POCKET_TANK_IMU_MPU6050_UP_NEGATIVE
        bool "MPU-6050: that axis reads negative when held right side up"
        default n
        depends on POCKET_TANK_IMU_MPU6050
    config POCKET_TANK_IMU_MPU6050_OUT_AXIS
        int "MPU-6050: the axis out of the glass (0=X 1=Y 2=Z)"
        range 0 2
        default 2
        depends on POCKET_TANK_IMU_MPU6050
        help
            The axis that carries gravity when the board lies flat on its
            back. The flip ignores it: lying flat holds the last orientation.
    config POCKET_TANK_IMU_MPU6050_OUT_NEGATIVE
        bool "MPU-6050: that axis reads negative lying flat, screen up"
        default n
        depends on POCKET_TANK_IMU_MPU6050
        help
            Only the face-down gesture uses it: lying screen down reads the
            other sign.
    config POCKET_TANK_IMU_AUTO_FLIP
        bool "The IMU turns the picture over when the board is turned over"
        default y
        depends on (POCKET_TANK_IMU_QMI8658 || POCKET_TANK_IMU_MPU6050) && !POCKET_TANK_IMU_FACE_DOWN_SLEEP
        help
            Off: the IMU only senses handling (the tank light, the codec's
            warm-up), and the settings page's SCREEN row alone says which
            way up the picture is. The face-down gesture's builds always
            let the IMU turn the picture.
    config POCKET_TANK_IMU_FACE_DOWN_SLEEP
        bool "Face down sleeps the tank, face up wakes it"
        default y if POCKET_TANK_CYD_320X240
        default n
        depends on POCKET_TANK_IMU_QMI8658 || POCKET_TANK_IMU_MPU6050
        help
            Screen down and still for 2 s is a short press of the sleep key;
            turned face up, the tank wakes in place (in the deepsleep mode,
            only within its 20-minute grace). What the gesture does follows
            the sleep mode - on the 320x240 boards the settings page's SLEEP
            row, whose NEVER ignores it as it does every other way into sleep.
            Once an IMU answers, the compact settings page's SCREEN row is
            ROTATION (the IMU turns the picture itself).
    choice POCKET_TANK_SLEEP_MODE
        prompt "Sleep mode: what the sleep key, face down and the director's sleeps do"
        default POCKET_TANK_SLEEP_DEEP
        help
            Every way into sleep goes through this: BOOT's short press (no
            PMIC), the PWR key (short and long), the face-down gesture, and
            the director's deepsleep and poweroff. The modes that go dark
            (screen, lightsleep) save the tank, turn the backlight and the
            sound off and stop drawing; a touch or a pick-up or tilt (face
            up instead, after a face-down sleep), BOOT, the PWR key, or the
            director's timer lights it again where it was. The touch that
            wakes it does nothing in the tank. Made for the CYD, whose case
            covers BOOT, and offered on the 320x240 boards (this fork,
            2026-10-08: the Touch-LCD-2's too, its CST816D's INT armed as a
            light-sleep wake as the CYD's FT6336's is): the AMOLED's panel
            sleep holds its touch controller in reset and cuts the panel's
            rails, so its dark could not wake on a touch, and cycling those
            rails beside an awake IMU is what railed its X and Z on
            2026-08-31.
            On the 320x240 boards, none, screen and lightsleep are only the
            factory default: the settings page's SLEEP row (NEVER / SCREEN /
            LIGHT) changes the mode at run time, and the choice is kept in
            NVS ("tank"/"sleep"). deepsleep is a build choice only, with no
            row.
        config POCKET_TANK_SLEEP_NONE
            bool "none: never goes dark; every way into sleep is ignored, with a log line"
        config POCKET_TANK_SLEEP_SCREEN
            bool "screen: dark, the CPU running"
            depends on POCKET_TANK_320X240
        config POCKET_TANK_SLEEP_LIGHT
            bool "lightsleep: dark, light-sleeping between looks; never deep sleep"
            depends on POCKET_TANK_320X240
            help
                While a USB host is attached the chip stays awake instead,
                as in screen: light sleep takes the USB port down.
        config POCKET_TANK_SLEEP_DEEP
            bool "deepsleep: the 20-minute grace, then deep sleep or the PMIC power-off"
            help
                As the tank has always slept: within the grace BOOT, the
                PWR key or face up wakes it in place; after it only BOOT,
                the PWR key or the director's timer does, with a boot.
    endchoice
    config POCKET_TANK_NO_PIE
        bool "Disable the PIE SIMD inference kernel (scalar dot products)"
        default n
        help
            Enable for a QEMU build if the emulator lacks ESP32-S3 PIE support.
endmenu
```
